/*
 * Copyright (c) 2024 The ZMK Contributors
 *
 * SPDX-License-Identifier: MIT
 */
#include <behaviors.dtsi>
#include <dt-bindings/zmk/keys.h>
#include <dt-bindings/zmk/bt.h>
#include <dt-bindings/zmk/outputs.h>
#define BASE 0
#define BLE 1
/ {
    keymap {
        compatible = "zmk,keymap";
        base_layer {
            display-name = "BASE";
            bindings = 
                &kp M  &kp C_VOL_DN  &kp C_PLAY_PAUSE  &kp C_VOL_UP  &kp O
            >;
        };
        ble_layer {
            display-name = "BLE";
            bindings = 
                &trans  &out OUT_TOG  &bt BT_PRV  &bt BT_NXT  &bt BT_CLR
            >;
        };
    };
};
